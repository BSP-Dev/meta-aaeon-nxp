## conf/layer.conf
```bitbake
# We have a conf and classes directory, add to BBPATH
BBPATH .= ":${LAYERDIR}"

# We have recipes-* directories, add to BBFILES
BBFILES += "${LAYERDIR}/recipes-*/*/*.bb"

# Add recipes-graphics/wayland/weston-init.bbappend conditionally for MACHINE=ucom-imx93-v2
BBFILES += "${@' '.join([f for f in ['${LAYERDIR}/recipes-graphics/wayland/weston-init.bbappend'] if d.getVar('MACHINE') == 'ucom-imx93-v2'])}"
BBFILES += "${@' '.join([f for f in ['${LAYERDIR}/recipes-bsp/imx-atf/*.bbappend'] if d.getVar('MACHINE') in ['ucom-imx8p-2g', 'ucom-imx8p-4g']])}"
BBFILES += "${@' '.join([f for f in ['${LAYERDIR}/recipes-bsp/u-boot/*.bbappend'] if d.getVar('MACHINE') in ['ucom-imx8p-2g', 'ucom-imx8p-4g']])}"
BBFILES += "${@' '.join([f for f in ['${LAYERDIR}/recipes-tools/*/*.bb'] if d.getVar('MACHINE') in ['ucom-imx8p-2g', 'ucom-imx8p-4g']])}"

BBFILES += "${LAYERDIR}/recipes-kernel/*/*.bbappend"

BBFILE_COLLECTIONS += "meta-aaeon-imx"
BBFILE_PATTERN_meta-aaeon-imx = "^${LAYERDIR}/"
BBFILE_PRIORITY_meta-aaeon-imx = "99"

LAYERSERIES_COMPAT_meta-aaeon-imx = "scarthgap"
```
